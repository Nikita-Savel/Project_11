int count = 5;                       // Счётчик полива при низком уровне воды
void setup() {                       // Основной цикл
  pinMode(2, OUTPUT);                // Настройка 2 цифрового пина на выход
  pinMode(7, OUTPUT);                // Настройка 7 цифрового пина на выход
  pinMode(10, OUTPUT);               // Настройка 10 цифрового пина на выход
  Serial.begin(9600);                // Инициализация передачи данных в монитор последовательного порта
  digitalWrite(2, LOW);              // Выключение реле, которое управляет насосом (прямая схема)
  digitalWrite(10, LOW);             // Выключение светодиода
 }
 void loop() {                       // Повторяющийся цикл
  for (int i = 1; i < 11; i++) {     // 10-краткое мигание светодиодом
    digitalWrite(10, HIGH);          // Включение светодиода
    delay(100);                      // Пауза 0,1 секунды
    digitalWrite(10, LOW);           // Выключение светодиода
    delay(100);                      // Пауза 0,1 секунды
  }

  int val = analogRead(0);           // Получение значения влажности почвы с датчика
  Serial.print("Humidity: ");        // Вывод фразы в монитор порта
  Serial.print(val);                 // Вывод значения влажности почвы в монитор порта

  int level = analogRead(1);         // Получение значения уровня жидкости с датчика
  Serial.print("     ");             // Вывод пробелов в монитор порта
  Serial.print("Water level: ");     // Вывод фразы в монитор порта
  Serial.print(level);               // Вывод значения уровня жидкости в монитор порта
  Serial.print("     ");             // Вывод пробелов в монитор порта
  Serial.print("count: ");           // Вывод фразы в монитор порта
  Serial.println(count);             // Вывод значения счётчика в монитор порта

  if (level >= 250) {                // Если значение уровня жидкости больше или равно 250
    count = 5;                       // Значение счётчика равно 5
  }

  if (val < 200) {                   // Если значение влажности почвы меньше 200
    if (level >= 250) {              // Если значение уровня жидкости больше или равно 250
      digitalWrite(10, HIGH);        // Включение светодиода
      digitalWrite(2, HIGH);         // Включение реле, которое управляет насосом (прямая схема)
      delay(10000);                  // Пауза 10 секунд
      digitalWrite(2, LOW);          // Выключение светодиода
      digitalWrite(10, LOW);         // Выключение реле, которое управляет насосом (прямая схема)
      delay(587900);                 // Пауза 9 минут 47,9 секунд
    } else {
      if (count > 0) {               // Если значение счётчика больше 0
        digitalWrite(10, HIGH);      // Включение светодиода
        digitalWrite(2, HIGH);       // Включение реле, которое управляет насосом (прямая схема)
        delay(10000);                // Пауза 10 секунд
        digitalWrite(2, LOW);        // Выключение светодиода
        digitalWrite(10, LOW);       // Выключение реле, которое управляет насосом (прямая схема)
        count = count - 1;           // Уменьшить значение счётчика на 1
        delay(587900);               // Пауза 9 минут 47,9 секунд
      }
      else {
        digitalWrite(10, LOW);       // Выключение светодиода
        digitalWrite(2, LOW);        // Выключение реле, которое управляет насосом (прямая схема)
        delay(597900);               // Пауза 9 минут 57,9 секунд
      }
    }
  }
  else {
      digitalWrite(10, LOW);         // Выключение светодиода
      digitalWrite(2, LOW);          // Выключение насоса
      delay(597900);                 // Пауза 9 минут 57,9 секунд
  }
}
