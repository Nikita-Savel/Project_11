#include <iarduino_RTC.h>                                      // Подключение библиотеки для модуля времени
#include <stdio.h>                                             // Подключение общей библиотеки
#include <stdlib.h>                                            // Подключение библиотеки для выделения памяти
iarduino_RTC time(RTC_DS3231);                                 // Объявляем объект time для модуля на базе модуля DS 3231

void setup() {                                                 // Основной цикл
  pinMode(2, OUTPUT);                                          // Настройка 2 цифрового пина на выход
  pinMode(10, OUTPUT);                                         // Настройка 10 цифрового пина на выход
  digitalWrite(2, HIGH);                                       // Выключение реле, которое управляет освещением (инверсная схема)
  digitalWrite(10, LOW);                                       // Выключение светодиод
  Serial.begin(9600);                                          // Инициализация передачи данных в монитор последовательного порта
  time.begin();                                                // Инициализация модуля DS 3231
  time.settime(0, 55, 10, 5, 2, 23, 7);                        // Устанавливаем время: 10 часов 55 минут 0 сек, 05, февраля, 2023 года, воскресенье
}

void loop() {                                                  // Повторяющийся цикл
  if (millis() % 1000 == 0) {                                  // Если прошла 1 секунда
    char *Str1 = time.gettime("H");
    int Num1 = 0;
    Num1 = atoi (Str1);                                        // Перевод в целочисленный тип значение часов
    char *Str2 = time.gettime("i");
    int Num2 = 0;
    Num2 = atoi (Str2);                                        // Перевод в целочисленный тип значение минут
    int Sum = Num1 * 60 + Num2;                                // Количество минут, прошедших с 00:00
    Serial.println(time.gettime("d-m-Y, H:i:s, D"));           // Вывод времени в монитор порта

    if (Sum == 1290) {                                         // Если время 21:30
      digitalWrite(10, LOW);                                   // Выключить светодиод
      digitalWrite(2, HIGH);                                   // Выключить реле, которое управляет освещением (инверсная схема)
    }
    
    if ((Sum < 1290) && (Sum >= 390) && (Sum % 10 == 0)) {     // С 6:30 по 21:30 раз в 10 минут осуществляется проверка уровня освещённости
      for (int i = 1; i < 11; i++) {                           // 10-краткое мигание светодиодом
        digitalWrite(10, HIGH);                                // Включение светодиода
        delay(100);                                            // Пауза 0,1 секунды
        digitalWrite(10, LOW);                                 // Выключение светодиода
        delay(100);                                            // Пауза 0,1 секунды
      }

      int val = analogRead(0);                                 // Получение значения освещённости с фоторезистора
      Serial.print(time.gettime("d-m-Y, H:i:s, D"));           // Вывод времени в монитор порта
      Serial.print("     ");                                   // Вывод пробелов в монитор порта
      Serial.print("Illumination: ");                          // Вывод фразы в монитор порта
      Serial.println(val);                                     // Вывод значения освещённости в монитор порта

      if (val > 350) {                                         // Если значение освещённости больше 350
        digitalWrite(2, LOW);                                  // Включение реле, которое управляет освещением (инверсная схема)
        digitalWrite(10, HIGH);                                // Включение светодиода
      } else {
        digitalWrite(2, HIGH);                                 // Выключение реле, которое управляет освещением (инверсная схема)
        digitalWrite(10, LOW);                                 // Выключение светодиода
      }
      delay(57000);                                            // Пауза 57 секунд
    }
  }
}
